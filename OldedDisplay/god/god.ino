//WOKWI for simulating


const unsigned char senpai[] PROGMEM = {
  0x00, 0x00, 0x00, 0x00, 0x00, 0x00, 0x00, 0x00, 0x00, 0x00, 0x00, 0x00, 0x00, 0x00, 0x00, 0x00,
  0x00, 0x00, 0x00, 0x00, 0x00, 0x00, 0x00, 0x00, 0x00, 0x00, 0x00, 0x00, 0x00, 0x00, 0x00, 0x00,
  0x00, 0x00, 0x00, 0x00, 0x00, 0x00, 0x00, 0x00, 0x00, 0x00, 0x00, 0x00, 0x00, 0x00, 0x00, 0x00,
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  0x00, 0x00, 0x00, 0x00, 0x00, 0x00, 0x00, 0x00, 0x03, 0x80, 0x00, 0x00, 0x00, 0x00, 0x00, 0x00
};


const unsigned char face1[] PROGMEM = {
  0x00, 0x00, 0x00, 0x00, 0x00, 0x00, 0x00, 0x00, 0x00, 0x00, 0x00, 0x00, 0x00, 0x00, 0x00, 0x00,
  0x00, 0x00, 0x00, 0x00, 0x00, 0x00, 0x00, 0x00, 0x00, 0x00, 0x00, 0x00, 0x00, 0x00, 0x00, 0x00,
  0x00, 0x00, 0x00, 0x00, 0x00, 0x00, 0x00, 0x00, 0x00, 0x00, 0x00, 0x00, 0x00, 0x00, 0x00, 0x00,
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  0x00, 0x00, 0x00, 0x00, 0x00, 0x00, 0x00, 0x00, 0x00, 0x00, 0x00, 0x00, 0x00, 0x00, 0x00, 0x00
};

const unsigned char face2[] PROGMEM = {
  0x00, 0x00, 0x00, 0x00, 0x00, 0x00, 0x00, 0x00, 0x00, 0x00, 0x00, 0x00, 0x00, 0x00, 0x00, 0x00,
  0x00, 0x00, 0x00, 0x00, 0x00, 0x00, 0x00, 0x00, 0x00, 0x00, 0x00, 0x00, 0x00, 0x00, 0x00, 0x00,
  0x00, 0x00, 0x00, 0x00, 0x00, 0x00, 0x00, 0x00, 0x00, 0x00, 0x00, 0x00, 0x00, 0x00, 0x00, 0x00,
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  0x00, 0x00, 0x00, 0x00, 0x00, 0x00, 0x00, 0x00, 0x00, 0x00, 0x00, 0x00, 0x00, 0x00, 0x00, 0x00
};
const unsigned char face3[] PROGMEM = {
  0x00, 0x00, 0x00, 0x00, 0x00, 0x00, 0x00, 0x00, 0x00, 0x00, 0x00, 0x00, 0x00, 0x00, 0x00, 0x00,
  0x00, 0x00, 0x00, 0x00, 0x00, 0x00, 0x00, 0x00, 0x00, 0x00, 0x00, 0x00, 0x00, 0x00, 0x00, 0x00,
  0x00, 0x00, 0x00, 0x00, 0x00, 0x00, 0x00, 0x00, 0x00, 0x00, 0x00, 0x00, 0x00, 0x00, 0x00, 0x00,
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  0x00, 0x00, 0x00, 0x00, 0x00, 0x00, 0x00, 0x00, 0x00, 0x00, 0x00, 0x00, 0x00, 0x00, 0x00, 0x00
};

const unsigned char face40[] PROGMEM = {
  0x00, 0x00, 0x00, 0x00, 0x00, 0x00, 0x00, 0x00, 0x00, 0x00, 0x00, 0x00, 0x00, 0x00, 0x00, 0x00,
  0x00, 0x00, 0x00, 0x00, 0x00, 0x00, 0x00, 0x00, 0x00, 0x00, 0x00, 0x00, 0x00, 0x00, 0x00, 0x00,
  0x00, 0x00, 0x00, 0x00, 0x00, 0x00, 0x00, 0x00, 0x00, 0x00, 0x00, 0x00, 0x00, 0x00, 0x00, 0x00,
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  0x00, 0x00, 0x00, 0x00, 0x00, 0x00, 0x00, 0x00, 0x00, 0x00, 0x00, 0x00, 0x00, 0x00, 0x00, 0x00
};

const unsigned char face4[] PROGMEM = {
  0x00, 0x00, 0x00, 0x00, 0x00, 0x00, 0x00, 0x00, 0x00, 0x00, 0x00, 0x00, 0x00, 0x00, 0x00, 0x00,
  0x00, 0x00, 0x00, 0x00, 0x00, 0x00, 0x00, 0x00, 0x00, 0x00, 0x00, 0x00, 0x00, 0x00, 0x00, 0x00,
  0x00, 0x00, 0x00, 0x00, 0x00, 0x00, 0x00, 0x00, 0x00, 0x00, 0x00, 0x00, 0x00, 0x00, 0x00, 0x00,
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  0x00, 0x00, 0x00, 0x00, 0x00, 0x00, 0x00, 0x00, 0x00, 0x00, 0x00, 0x00, 0x00, 0x00, 0x00, 0x00
};

#include <Wire.h>
#include <Adafruit_GFX.h>
#include <Adafruit_SSD1306.h>

#define SCREEN_WIDTH 128  // OLED display width, in pixels
#define SCREEN_HEIGHT 64  // OLED display height, in pixels
#define OLED_RESET -1     // Reset pin # (or -1 if sharing Arduino reset pin)

Adafruit_SSD1306 display(SCREEN_WIDTH, SCREEN_HEIGHT, &Wire, OLED_RESET);
#define prellZeit 50
#define buttonDown 3
#define selectButton 7


bool taste;
bool tasteAlt;
bool steigFlanke;
bool fallFlanke;
unsigned long letzteFlankenZeit = 0;
unsigned long laengeLauflicht = 5;

unsigned long zeitSchritt = 10 ;
unsigned long letzteZeit;


bool entprelterTaster(int taster) {
  tasteAlt = taste;
  taste = !digitalRead(taster);
  steigFlanke = !tasteAlt && taste;
  fallFlanke = tasteAlt && !taste;

  if (steigFlanke && (millis() >= letzteFlankenZeit + prellZeit)) {
    letzteFlankenZeit = millis();
    return true;
  }

  if (fallFlanke) {
    letzteFlankenZeit = millis();

  }
return false;
}


void setup() {
  display.begin(SSD1306_SWITCHCAPVCC, 0x3C);
  display.clearDisplay();       // Clear the display buffer
  display.setTextColor(WHITE);  // Set text color to white
  display.setTextSize(1);       // Set text size to 1
  display.setCursor(0, 0);      // Set cursor position to (0,0)
  pinMode(buttonDown, INPUT);
  pinMode(selectButton, INPUT);
  io();
}
int selection;
void loop() {
  switch (selection) {
    case 1:
      fried();
    case 2:
      nici();
    case 3:
      scrolling();

    case 4:
      mill();
    default:
      io();
  }
}




void io() {

  for (;;) {

    if (digitalRead(7) == HIGH) {
      loop();
    }

    display.clearDisplay();
    display.setTextSize(1);
    display.setTextColor(WHITE);
    display.setCursor(1, 20);

    if (selection == 1) {
      display.print("   ");
    }
    display.println("fried");
    if (selection == 2) {
      display.print("   ");
    }
    display.println("nici");
    if (selection == 3) {
      display.print("   ");
    }
    display.println("scroling");
    if (selection == 4) {
      display.print("   ");
    }
    display.println("mill");

    display.display();

    if (entprelterTaster(3) == true) {
      selection++;
      if (selection > 4) {
        selection = 1;
      }
    }
  }
}



void nici() {

  display.clearDisplay();

  display.drawLine(64, 0, 64 + 16, 32, WHITE);
  display.drawLine(64 - 16, 32, 64, 0, WHITE);


  display.drawRect((128 / 2) - (32 / 2), 32, 32, 32, WHITE);
  display.drawRect((128 / 2) - (32 / 2), 32, 32, 32, WHITE);

  display.drawLine(32 + 16, 32, (128 / 2) + 16, 64, WHITE);
  display.drawLine(32 + 16, 64, 64 + 16, 32, WHITE);
  display.display();
  while (entprelterTaster(7) == LOW);
  setup();
}


void scrolling() {


  display.clearDisplay();
  display.setTextSize(1);
  display.setCursor(0, 0);
  display.print("hello");

  display.setCursor(20, 10);
  display.print("world");

  display.setCursor(40, 20);
  display.print("how");
  
  display.setCursor(60, 30);
  display.print("are");

  display.setCursor(80, 40);
  display.print("you");

  display.setTextSize(1.5);
  display.setCursor(100, 50);
  display.print("<3");

  display.display();
  display.startscrollright(0, 7);

while(entprelterTaster(7)==LOW){
  delay(1);
}
  display.stopscroll();
  io();
}




void mill() {
  do {
    int count = millis();
    display.clearDisplay();
    display.setTextSize(4);
    display.setTextColor(WHITE);
    display.setCursor(0, 0);
    display.println(count);
    display.display();
  } while (entprelterTaster(7) == LOW);
  setup();
}

void fried() {
  int zahl1;
  int zahl2;


  digitalWrite(LED_BUILTIN, HIGH);
  for (int i = 0; i < 1000; i++) {
    delay(1);
  }
  digitalWrite(LED_BUILTIN, LOW);



  display.clearDisplay();                           //for Clearing the display
  display.drawBitmap(0, 0, face1, 128, 64, WHITE);  // display.drawBitmap(x position, y position, bitmap data, bitmap width, bitmap height, color)
  display.display();

  for (int ia = 0; ia < 200; ia++) {
    delay(1);
  }
  //delay(2000);

  for (zahl1 = 1; zahl1 <= 50; zahl1++) {
    display.clearDisplay();                           //for Clearing the display
    display.drawBitmap(0, 0, face3, 128, 64, WHITE);  // display.drawBitmap(x position, y position, bitmap data, bitmap width, bitmap height, color)
    display.display();
    for (int ib = 0; ib < 600; ib++) {

      delay(1);
    }
    //delay(6000);

    display.clearDisplay();                           //for Clearing the display
    display.drawBitmap(0, 0, face2, 128, 64, WHITE);  // display.drawBitmap(x position, y position, bitmap data, bitmap width, bitmap height, color)
    display.display();
    for (int ic = 0; ic < 100; ic++) {
      delay(1);
      //delay(1000);
    }  //for end
    for (zahl2 = 1; zahl2 <= 25; zahl2++) {
      display.clearDisplay();                            //for Clearing the display
      display.drawBitmap(0, 0, face40, 128, 64, WHITE);  // display.drawBitmap(x position, y position, bitmap data, bitmap width, bitmap height, color)
      display.display();
      for (int id = 0; id < 100; id++) {


        delay(1);
      }
      //delay(1000);

      display.clearDisplay();                           //for Clearing the display
      display.drawBitmap(0, 0, face4, 128, 64, WHITE);  // display.drawBitmap(x position, y position, bitmap data, bitmap width, bitmap height, color)
      display.display();
      for (int ie = 0; ie < 100; ie++) {


        delay(1);
      }
    }
    setup();
  }
}



/*lib 

# Wokwi Library List
# See https://docs.wokwi.com/guides/libraries

# Automatically added based on includes:
Adafruit GFX Library

U8g2_for_Adafruit_GFX
Adafruit SSD1306
*/

/*diagram

{
  "version": 1,
  "author": "Anonymous maker",
  "editor": "wokwi",
  "parts": [
    { "type": "wokwi-arduino-nano", "id": "nano", "top": -52.8, "left": 37.9, "attrs": {} },
    { "type": "board-ssd1306", "id": "oled1", "top": -150.46, "left": -76.57, "attrs": {} },
    {
      "type": "wokwi-pushbutton",
      "id": "btn1",
      "top": -109,
      "left": 249.6,
      "attrs": { "color": "green" }
    },
    {
      "type": "wokwi-pushbutton",
      "id": "btn2",
      "top": -41.8,
      "left": 249.6,
      "attrs": { "color": "green" }
    },
    {
      "type": "wokwi-resistor",
      "id": "r1",
      "top": -120.85,
      "left": 364.8,
      "attrs": { "value": "1000" }
    },
    {
      "type": "wokwi-resistor",
      "id": "r2",
      "top": 23.15,
      "left": 307.2,
      "attrs": { "value": "1000" }
    }
  ],
  "connections": [
    [ "btn2:1.l", "nano:5V", "red", [ "h-28.8", "v57.6", "h-57.6" ] ],
    [ "nano:3", "btn1:1.r", "green", [ "v-86.4", "h182.4", "v38.4" ] ],
    [ "oled1:VCC", "nano:5V", "red", [ "v-28.8", "h96.15", "v105.6", "h-48", "v96", "h144" ] ],
    [
      "oled1:GND",
      "nano:GND.1",
      "black",
      [ "v-48", "h115.2", "v105.6", "h-67.2", "v134.4", "h-9.6" ]
    ],
    [ "r1:1", "btn1:1.r", "black", [ "v0" ] ],
    [ "nano:GND.1", "r2:1", "black", [ "v38.4", "h115.2" ] ],
    [ "nano:GND.1", "r1:2", "black", [ "v48", "h240" ] ],
    [ "r2:2", "btn2:2.r", "black", [ "v0" ] ],
    [ "nano:7", "btn2:2.r", "green", [ "v-99.37", "h232.43", "v123.06" ] ],
    [ "oled1:SDA", "nano:A4", "green", [ "v178.31", "h135.48" ] ],
    [ "nano:A5", "oled1:SCL", "green", [ "v30.07", "h-155.44" ] ],
    [ "nano:5V", "btn1:2.l", "red", [ "v12.33", "h69.6", "v-96.76" ] ]
  ],
  "dependencies": {}
}
*/
